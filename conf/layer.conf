## conf/layer.conf
```bitbake
# We have a conf and classes directory, add to BBPATH
BBPATH .= ":${LAYERDIR}"

# We have recipes-* directories, add to BBFILES
BBFILES += "${LAYERDIR}/recipes-*/*/*.bb \
            ${LAYERDIR}/recipes-*/*/*.bbappend"

BBFILE_COLLECTIONS += "meta-evergreen"
BBFILE_PATTERN_meta-evergreen = "^${LAYERDIR}/"
BBFILE_PRIORITY_meta-evergreen = "6"

LAYERDEPENDS_meta-evergreen = "core"
LAYERSERIES_COMPAT_meta-evergreen = "kirkstone"
```
